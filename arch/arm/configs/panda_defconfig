## arch/arm/plat-omap/Kconfig
```kconfig
if ARCH_OMAP

menu "TI OMAP Common Features"

config ARCH_OMAP_OTG
	bool

choice
	prompt "OMAP System Type"
	default ARCH_OMAP2PLUS

config ARCH_OMAP1
	bool "TI OMAP1"
	select CLKDEV_LOOKUP
	select CLKSRC_MMIO
	help
	  "Systems based on omap7xx, omap15xx or omap16xx"

config ARCH_OMAP2PLUS
	bool "TI OMAP2/3/4"
	select CLKDEV_LOOKUP
	select GENERIC_IRQ_CHIP
	select OMAP_DM_TIMER
	help
	  "Systems based on OMAP2, OMAP3 or OMAP4"

endchoice

comment "OMAP Feature Selections"

config OMAP_DEBUG_DEVICES
	bool
	help
	  For debug cards on TI reference boards.

config OMAP_DEBUG_LEDS
	bool
	depends on OMAP_DEBUG_DEVICES
	default y if LEDS_CLASS

config OMAP_RPMSG
	tristate "OMAP Virtio-based remote processor messaging support"
	depends on ARCH_OMAP4
	default y
	select VIRTIO
	select VIRTIO_RING
	select OMAP_MBOX_FWK
	help
	  Say Y if you want to enable OMAP virtio-based remote-processor
	  communication, currently only available with OMAP4. This is required
	  for offloading tasks to the remote on-chip M3s or C64x+ dsp,
	  usually used by multimedia frameworks to offload cpu-intensive and/or
          latency-sensitive tasks.

config OMAP_RPMSG_RECOVERY
	bool "OMAP RPMSG recovery"
	default y
	depends on OMAP_RPMSG
	help
	  Say Y if you want RPMSG to reset the rpmsg channels after a fatal
	  error in remote proc. That way it will restart all the channels and
	  the remote processor, causing a clean restart.

config OMAP_SMARTREFLEX
	bool "SmartReflex support"
	depends on (ARCH_OMAP3 || ARCH_OMAP4) && PM
	help
	  Say Y if you want to enable SmartReflex.

	  SmartReflex can perform continuous dynamic voltage
	  scaling around the nominal operating point voltage
	  according to silicon characteristics and operating
	  conditions. Enabling SmartReflex reduces power
	  consumption.

	  Please note, that by default SmartReflex is only
	  initialized. To enable the automatic voltage
	  compensation for vdd mpu  and vdd core from user space,
	  user must write 1 to
		/debug/voltage/vdd_<X>/smartreflex/autocomp,
	  where X is mpu or core for OMAP3.
	  Optionally autocompensation can be enabled in the kernel
	  by default during system init via the enable_on_init flag
	  which an be passed as platform data to the smartreflex driver.

config OMAP_SMARTREFLEX_CLASS3
	bool "Class 3 mode of Smartreflex Implementation"
	depends on OMAP_SMARTREFLEX && TWL4030_CORE
	help
	  Say Y to enable Class 3 implementation of Smartreflex

	  Class 3 implementation of Smartreflex employs continuous hardware
	  voltage calibration.

config OMAP_SMARTREFLEX_CLASS1P5
	bool "Class 1.5 mode of Smartreflex Implementation"
	depends on OMAP_SMARTREFLEX
	help
	  Say Y to enable Class 1.5 implementation of Smartreflex.

	  Class 1.5 implementation of Smartreflex employs software controlled
	  hardware voltage calibration.

config OMAP_SR_CLASS1P5_RECALIBRATION_DELAY
	int "Class 1.5 mode recalibration recalibration delay(ms)"
	depends on OMAP_SMARTREFLEX_CLASS1P5
	default 86400000
	help
	  Setup the recalibration delay in milliseconds.

	  Use 0 for never doing a recalibration (operates in AVS Class 1 mode).
	  Defaults to recommended recalibration every 24hrs.
	  If you do not understand this, use the default.

config OMAP_RESET_CLOCKS
	bool "Reset unused clocks during boot"
	depends on ARCH_OMAP
	help
	  Say Y if you want to reset unused clocks during boot.
	  This option saves power, but assumes all drivers are
	  using the clock framework. Broken drivers that do not
	  yet use clock framework may not work with this option.
	  If you are booting from another operating system, you
	  probably do not want this option enabled until your
	  device drivers work properly.

config OMAP_MUX
	bool "OMAP multiplexing support"
	depends on ARCH_OMAP
	default y
	help
	  Pin multiplexing support for OMAP boards. If your bootloader
	  sets the multiplexing correctly, say N. Otherwise, or if unsure,
	  say Y.

config OMAP_MUX_DEBUG
	bool "Multiplexing debug output"
	depends on OMAP_MUX
	help
	  Makes the multiplexing functions print out a lot of debug info.
	  This is useful if you want to find out the correct values of the
	  multiplexing registers.

config OMAP_MUX_WARNINGS
	bool "Warn about pins the bootloader didn't set up"
	depends on OMAP_MUX
	default y
	help
	  Choose Y here to warn whenever driver initialization logic needs
	  to change the pin multiplexing setup.	 When there are no warnings
	  printed, it's safe to deselect OMAP_MUX for your product.

config OMAP_MCBSP
	bool "McBSP support"
	depends on ARCH_OMAP
	default y
	help
	  Say Y here if you want support for the OMAP Multichannel
	  Buffered Serial Port.

config OMAP_MBOX_FWK
	bool "Mailbox framework support"
	depends on ARCH_OMAP
	help
	  Say Y here if you want to use OMAP Mailbox framework support for
	  DSP, IVA1.0 and IVA2 in OMAP1/2/3.

config OMAP_MBOX_KFIFO_SIZE
	int "Mailbox kfifo default buffer size (bytes)"
	depends on OMAP_MBOX_FWK
	default 256
	help
	  Specify the default size of mailbox's kfifo buffers (bytes).
	  This can also be changed at runtime (via the mbox_kfifo_size
	  module parameter).

config OMAP_IOMMU
	bool "IOMMU support for OMAP devices"

config OMAP_IOMMU_DEBUG
       bool "Export OMAP IOMMU internals in DebugFS"
       depends on OMAP_IOMMU && DEBUG_FS
       help
         Select this to see extensive information about
         the internal state of OMAP IOMMU in debugfs.

         Say N unless you know you need this.

config OMAP_IOMMU_IVA2
	bool

config OMAP_MPU_TIMER
	bool "Use mpu timer"
	depends on ARCH_OMAP1
	help
	  Select this option if you want to use the OMAP mpu timer. This
	  timer provides more intra-tick resolution than the 32KHz timer,
	  but consumes more power.

config OMAP_32K_TIMER
	bool "Use 32KHz timer"
	depends on ARCH_OMAP16XX || ARCH_OMAP2PLUS
	default y if (ARCH_OMAP16XX || ARCH_OMAP2PLUS)
	help
	  Select this option if you want to enable the OMAP 32KHz timer.
	  This timer saves power compared to the OMAP_MPU_TIMER, and has
	  support for no tick during idle. The 32KHz timer provides less
	  intra-tick resolution than OMAP_MPU_TIMER. The 32KHz timer is
	  currently only available for OMAP16XX, 24XX, 34XX and OMAP4.

config OMAP3_L2_AUX_SECURE_SAVE_RESTORE
	bool "OMAP3 HS/EMU save and restore for L2 AUX control register"
	depends on ARCH_OMAP3 && PM
	default n
	help
	  Without this option, L2 Auxiliary control register contents are
	  lost during off-mode entry on HS/EMU devices. This feature
	  requires support from PPA / boot-loader in HS/EMU devices, which
	  currently does not exist by default.

config OMAP3_L2_AUX_SECURE_SERVICE_SET_ID
	int "Service ID for the support routine to set L2 AUX control"
	depends on OMAP3_L2_AUX_SECURE_SAVE_RESTORE
	default 43
	help
	  PPA routine service ID for setting L2 auxiliary control register.

config OMAP_32K_TIMER_HZ
	int "Kernel internal timer frequency for 32KHz timer"
	range 32 1024
	depends on OMAP_32K_TIMER
	default "128"
	help
	  Kernel internal timer frequency should be a divisor of 32768,
	  such as 64 or 128.

config OMAP_DM_TIMER
	bool "Use dual-mode timer"
	depends on ARCH_OMAP16XX || ARCH_OMAP2PLUS
	help
	 Select this option if you want to use OMAP Dual-Mode timers.

config OMAP_SERIAL_WAKE
	bool "Enable wake-up events for serial ports"
	depends on ARCH_OMAP1 && OMAP_MUX
	default y
	help
	  Select this option if you want to have your system wake up
	  to data on the serial RX line. This allows you to wake the
	  system from serial console.

config OMAP_TEMP_SENSOR
	bool "OMAP Temp Sensor Support"
	depends on ARCH_OMAP4
	default n
	help
		Say Y here if you want support for the temp sensor on OMAP4460.
		This provides the temperature of the MPU
		subsystem. Only one instance of on die temperature
		sensor is present.

# this carveout should probably become generic and not omap specific
config OMAP_REMOTEPROC_MEMPOOL_SIZE
	hex "Physical carveout memory pool size (Byte)"
	depends on OMAP_REMOTE_PROC
	default 0x700000
	help
	  Allocate specified size of memory at boot time so we can ioremap
	  it safely.

choice
	prompt "OMAP PM layer selection"
	depends on ARCH_OMAP
	default OMAP_PM

config OMAP_PM_NONE
	bool "No PM layer"

config OMAP_PM_NOOP
	bool "No-op/debug PM layer"

config OMAP_PM
	depends on PM
	bool "OMAP PM layer implementation"
endchoice

endmenu

endif
```

## drivers/gpu/ion/Kconfig
```kconfig
menuconfig ION
	tristate "Ion Memory Manager"
	select GENERIC_ALLOCATOR
	help
	  Chose this option to enable the ION Memory Manager.

config ION_TEGRA
	tristate "Ion for Tegra"
	depends on ARCH_TEGRA && ION
	help
	  Choose this option if you wish to use ion on an nVidia Tegra.

config ION_OMAP
	tristate "Ion for OMAP"
	depends on ARCH_OMAP4 && ION && TI_TILER
	help
	  Choose this option if you wish to use ion on OMAP4.
```

## drivers/gpu/pvr/Kconfig
```kconfig
config PVR_SGX
	tristate "PowerVR SGX support"
	depends on ARCH_OMAP && OMAP2_DSS
	select PVR_OMAP_DSS2
	help
	  Enable this option to build support for the PowerVR SGX 3D core.

	  To compile this driver as a module, choose M here:
	  this will generate two modules, called pvrsrvkm and omaplfb.

choice
	prompt "PowerVR SGX core"
	depends on PVR_SGX
	default PVR_SGXCORE_540

config PVR_SGXCORE_540
	bool "SGX 540"

endchoice

choice
	prompt "PowerVR build type"
	depends on PVR_SGX
	default PVR_BUILD_RELEASE

config PVR_BUILD_RELEASE
	bool "Release"

config PVR_BUILD_DEBUG
	bool "Debug"

endchoice

# Release build debugging options

config PVR_NEED_PVR_DPF
	bool "Enable debugging messages in release build"
	depends on PVR_BUILD_RELEASE

config PVR_NEED_PVR_ASSERT
	bool "Enable assertions in release build"
	depends on PVR_BUILD_RELEASE

# Debugging options

config PVR_DEBUG_MEMORY
	bool "Record memory-related debugging information"
	depends on PVR_BUILD_DEBUG
	default y

config PVR_DEBUG_BRIDGE_KM
	bool "Collect bridge statistics"
	depends on PVR_BUILD_DEBUG
	default y

config PVR_DEBUG_TRACE_BRIDGE_KM
	bool "Trace bridge calls"
	depends on PVR_DEBUG_BRIDGE_KM
	default n

config PVR_DEBUG_BRIDGE_KM_DISPATCH_TABLE
	bool "Dump bridge dispatch table entries"
	depends on PVR_BUILD_DEBUG
	default n


#
# General options
#

config PVR_PERCONTEXT_PB
	bool "Per-context parameter buffer (recommended)"
	depends on PVR_SGX
	default y

config PVR_ACTIVE_POWER_MANAGEMENT
	bool "Support for active power management (recommended)"
	depends on PVR_SGX
	default y

config PVR_ACTIVE_POWER_LATENCY_MS
	int "Active power event latency (ms)"
	depends on PVR_ACTIVE_POWER_MANAGEMENT
	default 100

config PVR_SGX_LOW_LATENCY_SCHEDULING
	bool "Enable low-latency scheduling"
	depends on PVR_SGX
	default y

config PVR_USSE_EDM_STATUS_DEBUG
	bool "Trace microkernel status"
	depends on PVR_SGX
	default y if PVR_BUILD_DEBUG

config PVR_DUMP_MK_TRACE
	bool "Dump microkernel trace on HW recovery"
	depends on PVR_USSE_EDM_STATUS_DEBUG
	default y

config PVR_PDUMP
	bool "Support for parameter dumping (Pdump)"
	depends on PVR_SGX
	default n

config PVR_OMAP_DSS2
	bool

choice
	prompt "SGX DVFS mode"
	depends on PVR_SGX
	default SGX_DVFS_MODE_NONE

config SGX_DVFS_MODE_NONE
	bool "None"

config SGX_DVFS_MODE_LINEAR
	bool "Linear"

config SGX_DVFS_MODE_OPTIMIZED
	bool "Optimized"
endchoice

config SGX_DVFS_IDLE_TIMEOUT
	int "DVFS idle timeout (us)"
	depends on PVR_SGX
	default 1000

config PVR_LINUX_MEM_AREA_POOL
	bool "Enable uncached allocation pool"
	depends on PVR_SGX
	default n

config PVR_LINUX_MEM_AREA_POOL_MAX_PAGES
	int "Maximum number of pages in pool"
	depends on PVR_LINUX_MEM_AREA_POOL
	default 10800
	help
		Pool size in pages.
		A size of 0 disables the pool.
		A size of -1 allows the pool to grow indefinitely.
```

## drivers/media/video/omapgfx/Kconfig
```kconfig
config VIDEO_OMAP_GFX
	tristate "OMAP V4L2-GFX driver"
	select VIDEOBUF_GEN
	select OMAP2_DSS
	depends on VIDEO_DEV && (ARCH_OMAP34XX || ARCH_OMAP4)
	default m
	---help---
        V4L2 GFX support for OMAP based boards.
```

## drivers/misc/inv_mpu/Kconfig
```kconfig
config MPU_SENSORS_TIMERIRQ
	tristate "MPU Timer IRQ"
	help
	  If you say yes here you get access to the timerirq device handle which
	  can be used to select on.  This can be used instead of IRQ's, sleeping,
	  or timer threads.  Reading from this device returns the same type of
	  information as reading from the MPU and slave IRQ's.

menuconfig: INV_SENSORS
	bool "Motion Processing Unit"
	depends on I2C
	default n

if INV_SENSORS

config MPU_SENSORS_MPU3050
	tristate "MPU3050"
	depends on I2C && INV_SENSORS
	select MPU_SENSORS_MPU3050_GYRO
	help
	  If you say yes here you get support for the MPU3050 Gyroscope driver
	  This driver can also be built as a module.  If so, the module
	  will be called mpu3050.

source "drivers/misc/inv_mpu/accel/Kconfig"
source "drivers/misc/inv_mpu/compass/Kconfig"
source "drivers/misc/inv_mpu/pressure/Kconfig"

endif #INV_SENSORS
```

## drivers/misc/modem_if/Kconfig
```kconfig
menuconfig SEC_MODEM
	bool "Modem Interface Driver"
        default n
	---help---
	  Samsung Modem Interface Driver.

config UMTS_LINK_MIPI
	bool "modem driver link device MIPI-HSI"
	depends on SEC_MODEM
	default n

config UMTS_LINK_HSIC
	bool "modem driver link device HSIC"
	depends on SEC_MODEM
	default n

config UMTS_MODEM_XMM6260
	bool "modem chip : IMC xmm6260"
	depends on SEC_MODEM
	default n

config CDMA_LINK_DPRAM
	bool "modem driver link device DPRAM"
	depends on SEC_MODEM
	default n

config CDMA_MODEM_CBP71
	bool "modem chip : cbp71"
	depends on SEC_MODEM
	default n

config LTE_LINK_USB
	bool "modem driver link device US"
	depends on SEC_MODEM
	default n

config LTE_MODEM_CMC221
	bool "modem chip : cmc221"
	depends on SEC_MODEM
	default n
```

## drivers/omap_hsi/Kconfig
```kconfig
#
# OMAP HSI driver configuration
#

config OMAP_HSI
	bool "OMAP HSI hardware driver"
	depends on (ARCH_OMAP34XX || ARCH_OMAP4)
	default n
	---help---
	  If you say Y here, you will enable the OMAP HSI hardware driver.

	  Note: This module is a unified driver specific to OMAP. Efforts are
	  underway to create a vendor independent implementation.

	  The MIPI HSI is a High Speed Synchronous Serial Interface and is
	  defined for communication between two Integrated Circuits (the
	  typical scenario is an application IC and cellular modem IC
	  communication). Data transaction model is peer-to-peer.

	  Not all features required for a production device are implemented in
	  this driver. See the documentation for more information.

	  This physical layer provides logical channeling and several modes of
	  operation.

	  The OMAP HSI driver supports either:
	    - the OMAP MIPI HSI device
	    - the OMAP SSI device

choice
	prompt "Selected device support file"
	depends on OMAP_HSI && y
	default OMAP_HSI_DEVICE
	---help---
	  Adds the device support for one of the devices handled by the HSI
	  driver.

	  The OMAP HSI driver supports either:
	    - the OMAP MIPI HSI device
	    - the OMAP SSI device

config OMAP_HSI_DEVICE
	bool "HSI (OMAP MIPI HSI)"
	depends on ARCH_OMAP4

config OMAP_SSI_DEVICE
	bool "SSI (OMAP SSI)"
	depends on ARCH_OMAP34XX

endchoice

#
# OMAP HSI char device kernel configuration
#

config OMAP_HSI_CHAR
	tristate "OMAP HSI character driver"
	depends on OMAP_HSI
	---help---
	  If you say Y here, you will enable the OMAP HSI character driver.

	  This driver provides a simple character device interface for
	  serial communication over the HSI bus.

config OMAP_HSI_PROTOCOL
	tristate "HSI Protocol driver for Infineon Modem"
	depends on OMAP_HSI
	---help---
	  If you say Y here, you will enable the HSI Protocol driver.
	  This driver supports HSI protocol for Infineon Modem.
```
