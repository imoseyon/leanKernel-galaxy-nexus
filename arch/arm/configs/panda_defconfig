## drivers/remoteproc/Kconfig
```kconfig
#
# Generic framework for controlling remote processors
#

# Remote proc gets selected by whoever wants it.
config REMOTE_PROC
	tristate

config REMOTE_PROC_AUTOSUSPEND
	bool "Autosuspend support for remoteproc"
	depends on REMOTE_PROC
	default y
	help
          Say Y here if you want remote processor to suspend
          after some time of inactivity.

# can't be tristate, due to omap_device_* and omap_hwmod_* dependency
config OMAP_REMOTE_PROC
	bool "OMAP remoteproc support"
	depends on ARCH_OMAP4
	select OMAP_IOMMU
	select REMOTE_PROC
	default y
	help
	  Say y here to support OMAP's remote processors (dual M3
	  and DSP on OMAP4) via the remote processor framework.

	  Currently only supported on OMAP4.

	  Usually you want to say y here, in order to enable multimedia
	  use-cases to run on your platform (multimedia codecs are
	  offloaded to remote DSP processors using this framework).

	  It's safe to say n here if you're not interested in multimedia
	  offloading or just want a bare minium kernel.

config OMAP_RPRES
	bool "Remote Processor Resources"
	depends on OMAP_REMOTE_PROC
	default y
	help
	  Say Y here if you want to use OMAP remote processor resources
	  frame work.

config REMOTEPROC_WATCHDOG
	bool "OMAP remoteproc watchdog timer"
	depends on REMOTE_PROC
	default y
	help
	  Say y to enable watchdog timer for remote cores

config REMOTEPROC_CORE_DUMP
	bool "Support for extracting a core dump from a remote processor"
	depends on REMOTE_PROC
	default y
	help
	  Say y to enable extracting a core dump from a running remote
          processor at <debugfs>/remoteproc/<remoteproc>/core.  Extracting the
	  core dump does not pause the remote processor--this must be
	  implemented separately.
```

## drivers/rpmsg/Kconfig
```kconfig
config RPMSG
	tristate "Virtio-based remote processor messaging bus"
	default y
	select VIRTIO
	select VIRTIO_RING
	depends on OMAP_RPMSG
	---help---
	  This virtio driver provides support for shared-memory-based
          remote processor messaging, by registering the RPMSG bus which
          in turn enables a handful of IPC drivers.

	  Such support is usually required to offload cpu-intensive
          or latency-sensitive tasks to specialized remote processors with
          dedicated hardware accelerators and/or real-time properties.

	  If unsure, say N.

config RPMSG_OMX
	tristate "rpmsg OMX driver"
	default y
	depends on RPMSG
	depends on TI_TILER
	---help---
	  An rpmsg driver that exposes OMX API to user space, in order to
	  allow multimedia applications to offload OMX processing to
	  remote processors.

	  If unsure, say N.

config RPMSG_RESMGR
	tristate "rpmsg resource manager"
	default y
	depends on RPMSG
	depends on OMAP_RPRES
	---help---
	  Add Framework base on RPMSG to request and release resources
	  from a remote Processor.
	  Say either Y or M. You know you want to.

config RPMSG_CLIENT_SAMPLE
	tristate "An rpmsg client sample"
	default m
	depends on RPMSG
	---help---
	  This is just a sample client driver for the rpmsg bus.
	  Say either Y or M. You know you want to.

config RPMSG_SERVER_SAMPLE
	tristate "An rpmsg server sample"
	default m
	depends on RPMSG
	---help---
	  This is just a sample server driver for the rpmsg bus.
	  Say either Y or M. You know you want to.
```

## drivers/video/omap2/dsscomp/Kconfig
```kconfig
menuconfig DSSCOMP
        tristate "OMAP DSS Composition support (EXPERIMENTAL)"
        depends on OMAP2_DSS && PVR_SGX
	default y

        help
          Frame composition driver using OMAP DSS2.  Allows using all
	  DSS2 resources in a unified configuration.  Should not be used
	  together with other DSS2 devices, such as V4L2 or framebuffer.

config DSSCOMP_DEBUG_LOG
	bool "Log event timestamps in debugfs"
	default y
	depends on DEBUG_FS

	help
	  Takes timestamp for each callback and state transition, and
	  logs the last 128 entries (last few frames' worth) in a
	  log buffer.  This is a separate menuconfig in case this is
	  deemed an overhead.
```

## drivers/video/omap2/hdcp/Kconfig
```kconfig
menuconfig OMAP4_HDCP
	bool "OMAP4 HDCP support"
        depends on OMAP2_DSS && OMAP4_DSS_HDMI
        default n
	help
	  HDCP Interface. This adds the High Definition Content Protection Interface.
	  See http://www.digital-cp.com/ for HDCP specification.

config OMAP4_HDCP_DEBUG
	bool "OMAP4 HDCP Debugging"
        depends on OMAP4_HDCP
        default n
	help
	  Enableds verbose debugging the the HDCP drivers
```

## security/smc/Kconfig
```kconfig
config TF_MSHIELD
	bool

config SECURITY_MIDDLEWARE_COMPONENT
	bool "Enable SMC Driver"
	depends on ARCH_OMAP3 || ARCH_OMAP4
	default n
	select TF_MSHIELD
	help
	  This option adds kernel support for communication with the SMC
	  Protected Application.

	  If you are unsure how to answer this question, answer N.

config SMC_KERNEL_CRYPTO
	bool "Register SMC into kernel crypto subsytem"
	depends on SECURITY_MIDDLEWARE_COMPONENT
	default y
	help
	  This option enables crypto subsystem to use SMC and OMAP hardware
	  accelerators.

	  If you are unsure how to answer this question, answer Y.

config SECURE_TRACE
	bool "Enable SMC secure traces"
	depends on SECURITY_MIDDLEWARE_COMPONENT && ARCH_OMAP4
	default y
	help
	  This option enables traces from the SMC Protected Application to be
	  displayed in kernel logs.

config TF_DRIVER_DEBUG_SUPPORT
	bool "Debug support"
	depends on SECURITY_MIDDLEWARE_COMPONENT
	default n
	help
	  This options enables debug traces in the driver.

config SMC_BENCH_SECURE_CYCLE
	bool "Enable secure cycles benchmarks"
	depends on TF_DRIVER_DEBUG_SUPPORT && ARCH_OMAP4
	default n
	help
	  This options enables benchmarks.
```
